## package/libmilter/Config.in
```kconfig
config BR2_PACKAGE_LIBMILTER
	bool "libmilter"
	depends on !BR2_STATIC_LIBS
	depends on BR2_USE_MMU # fork()
	help
		libmilter

comment "libmilter needs a toolchain w/ dynamic library"
	depends on BR2_USE_MMU
	depends on BR2_STATIC_LIBS
```

## package/libpam-google-authenticator/Config.in
```kconfig
config BR2_PACKAGE_LIBPAM_GOOGLE_AUTHENTICATOR
	bool "libpam-google-authenticator"
	select BR2_PACKAGE_GOOGLE_AUTHENTICATOR
	help
	  Google Authenticator PAM authentification module.

	  https://github.com/google/google-authenticator-libpam 
```

## package/libspf2/Config.in
```kconfig
config BR2_PACKAGE_LIBSPF2
	bool "libspf2"
	depends on !BR2_STATIC_LIBS
	depends on BR2_USE_MMU # fork()
	help
		libspf2

comment "libspf2 needs a toolchain w/ dynamic library"
	depends on BR2_USE_MMU
	depends on BR2_STATIC_LIBS
```

## package/opendkim/Config.in
```kconfig
config BR2_PACKAGE_OPENDKIM
	bool "opendkim"
	depends on !BR2_STATIC_LIBS
	depends on BR2_USE_MMU # fork()
	help
		opendkim

comment "postfix needs a toolchain w/ dynamic library"
	depends on BR2_USE_MMU
	depends on BR2_STATIC_LIBS
```

## package/opendmarc/Config.in
```kconfig
config BR2_PACKAGE_OPENDMARC
	bool "opendmarc"
	depends on !BR2_STATIC_LIBS
	depends on BR2_USE_MMU # fork()
	help
		opendmarc

comment "opendmarc needs a toolchain w/ dynamic library"
	depends on BR2_USE_MMU
	depends on BR2_STATIC_LIBS
```

## package/perl-bytes-random-secure-tiny/Config.in
```kconfig
config BR2_PACKAGE_PERL_BYTES_RANDOM_SECURE_TINY
	bool "perl-bytes-random-secure-tiny"
	depends on !BR2_STATIC_LIBS
	help
	  Bytes::Random::Secure::Tiny - A tiny Perl extension to generate cryptographically-secure random bytes

	  https://metacpan.org/release/Bytes::Random::Secure::Tiny

comment "perl-bytes-random-secure-tiny needs a toolchain w/ dynamic library"
	depends on BR2_STATIC_LIBS
```

## package/perl-call-context/Config.in
```kconfig
config BR2_PACKAGE_PERL_CALL_CONTEXT
	bool "perl-call-context"
	depends on !BR2_STATIC_LIBS
	help
	  Call::Context - Sanity-check calling context

	  https://metacpan.org/release/Call-Context

comment "perl-call-context needs a toolchain w/ dynamic library"
	depends on BR2_STATIC_LIBS
```

## package/perl-class-accessor/Config.in
```kconfig
config BR2_PACKAGE_PERL_CLASS_ACCESSOR
	bool "perl-class-accessor"
	depends on !BR2_STATIC_LIBS
	help
	  Class::Accessor - Automated accessor generation

	  https://metacpan.org/release/Class-Accessor

comment "perl-class-accessor needs a toolchain w/ dynamic library"
	depends on BR2_STATIC_LIBS
```

## package/perl-class-tiny/Config.in
```kconfig
config BR2_PACKAGE_PERL_CLASS_TINY
	bool "perl-class-tiny"
	help
	  Class::Tiny - Minimalist class construction
```

## package/perl-crypt-format/Config.in
```kconfig
config BR2_PACKAGE_PERL_CRYPT_FORMAT
	bool "perl-crypt-format"
	depends on !BR2_STATIC_LIBS
	help
	  Crypt::Format - Conversion utilities for encryption applications

	  https://metacpan.org/release/Crypt-Format

comment "perl-crypt-format needs a toolchain w/ dynamic library"
	depends on BR2_STATIC_LIBS
```

## package/perl-crypt-perl/Config.in
```kconfig
config BR2_PACKAGE_PERL_CRYPT_PERL
	bool "perl-crypt-perl"
	depends on !BR2_STATIC_LIBS
	select BR2_PACKAGE_PERL_BYTES_RANDOM_SECURE_TINY
	select BR2_PACKAGE_PERL_CLASS_ACCESSOR
	select BR2_PACKAGE_PERL_CONVERT_ASN1
	select BR2_PACKAGE_PERL_CRYPT_FORMAT
	select BR2_PACKAGE_PERL_MATH_PROVABLEPRIME
	select BR2_PACKAGE_PERL_SYMBOL_GET
	select BR2_PACKAGE_PERL_TRY_TINY
	help
	  Crypt::Perl - Cryptography in pure Perl

	  https://metacpan.org/release/Crypt-Perl

comment "perl-crypt-perl needs a toolchain w/ dynamic library"
	depends on BR2_STATIC_LIBS
```

## package/perl-crypt-smime/Config.in
```kconfig
config BR2_PACKAGE_PERL_CRYPT_SMIME
	bool "perl-crypt-smime"
	depends on !BR2_STATIC_LIBS
	help
	  Perl S/MIME encryption module.

	  https://metacpan.org/release/Crypt-SMIME

comment "perl-crypt-smime needs a toolchain w/ dynamic library"
	depends on BR2_STATIC_LIBS
```

## package/perl-http-tiny-ua/Config.in
```kconfig
config BR2_PACKAGE_PERL_HTTP_TINY_UA
	bool "perl-http-tiny-ua"
	depends on !BR2_STATIC_LIBS
	select BR2_PACKAGE_PERL_HTTP_TINY
	select BR2_PACKAGE_PERL_CLASS_TINY
	help
	  HTTP::Tiny::UA - Higher-level UA features for HTTP::Tiny

	  https://metacpan.org/release/HTTP-Tiny-UA

comment "perl-http-tiny-ua needs a toolchain w/ dynamic library"
	depends on BR2_STATIC_LIBS
```

## package/perl-http-tiny/Config.in
```kconfig
config BR2_PACKAGE_PERL_HTTP_TINY
	bool "perl-http-tiny"
	depends on !BR2_STATIC_LIBS
	help
	  HTTP::Tiny - A small, simple, correct HTTP/1.1 client

	  https://metacpan.org/release/HTTP-Tiny

comment "perl-http-tiny needs a toolchain w/ dynamic library"
	depends on BR2_STATIC_LIBS
```

## package/perl-json/Config.in
```kconfig
config BR2_PACKAGE_PERL_JSON
	bool "perl-json"
	help
	  JSON - JSON (JavaScript Object Notation) encoder/decoder
```

## package/perl-math-provableprime/Config.in
```kconfig
config BR2_PACKAGE_PERL_MATH_PROVABLEPRIME
	bool "perl-math-provableprime"
	depends on !BR2_STATIC_LIBS
	help
	  Math::ProvablePrime - Generate a provable prime number, in pure Perl

	  https://metacpan.org/release/Math-ProvablePrime

comment "perl-math-provableprime needs a toolchain w/ dynamic library"
	depends on BR2_STATIC_LIBS
```

## package/perl-mozilla-ca/Config.in
```kconfig
config BR2_PACKAGE_PERL_MOZILLA_CA
	bool "perl-mozilla-ca"
	depends on !BR2_STATIC_LIBS
	help
	  Mozilla::CA - Mozilla's CA cert bundle in PEM format

	  https://metacpan.org/release/Mozilla-CA

comment "perl-mozilla-ca needs a toolchain w/ dynamic library"
	depends on BR2_STATIC_LIBS
```

## package/perl-net-acme2/Config.in
```kconfig
config BR2_PACKAGE_PERL_NET_ACME2
	bool "perl-net-acme2"
	depends on !BR2_STATIC_LIBS
	select BR2_PACKAGE_PERL_CALL_CONTEXT
	select BR2_PACKAGE_PERL_CRYPT_FORMAT
	select BR2_PACKAGE_PERL_CRYPT_PERL
	select BR2_PACKAGE_PERL_HTTP_TINY_UA
	select BR2_PACKAGE_PERL_IO_SOCKET_SSL
	select BR2_PACKAGE_PERL_JSON
	select BR2_PACKAGE_PERL_MODULE_RUNTIME
	select BR2_PACKAGE_PERL_X_TINY
	help
	  Net::ACME2::LetsEncrypt - Let's Encrypt's v2 API endpoint

	  https://metacpan.org/pod/Net::ACME2::LetsEncrypt

comment "perl-net-acme2 needs a toolchain w/ dynamic library"
	depends on BR2_STATIC_LIBS
```

## package/perl-symbol-get/Config.in
```kconfig
config BR2_PACKAGE_PERL_SYMBOL_GET
	bool "perl-symbol-get"
	depends on !BR2_STATIC_LIBS
	select BR2_PACKAGE_PERL_CALL_CONTEXT
	help
	  Symbol::Get - Read Perl's symbol table programmatically

	  https://metacpan.org/release/Symbol-Get

comment "perl-symbol-get needs a toolchain w/ dynamic library"
	depends on BR2_STATIC_LIBS
```

## package/perl-x-tiny/Config.in
```kconfig
config BR2_PACKAGE_PERL_X_TINY
	bool "perl-x-tiny"
	select BR2_PACKAGE_PERL_MODULE_RUNTIME
	help
	  X::Tiny - Base class for a bare-bones exception factory

	  https://metacpan.org/release/X-Tiny
```

## package/postfix/Config.in
```kconfig
config BR2_PACKAGE_POSTFIX
	bool "postfix"
	depends on !BR2_STATIC_LIBS
	depends on BR2_USE_MMU # fork()
	select BR2_PACKAGE_OPENSSL
	select BR2_PACKAGE_ZLIB
	help
		Postfix

comment "postfix needs a toolchain w/ dynamic library"
	depends on BR2_USE_MMU
	depends on BR2_STATIC_LIBS
```

## package/tinydns/Config.in
```kconfig
config BR2_PACKAGE_TINYDNS
	bool "tinydns"
	depends on !BR2_STATIC_LIBS
	depends on BR2_USE_MMU # fork()
	help
		tinydns

comment "tinydns needs a toolchain w/ dynamic library"
	depends on BR2_USE_MMU
	depends on BR2_STATIC_LIBS
```

## package/webserver/Config.in
```kconfig
config BR2_PACKAGE_WEBSERVER
	bool "webserver"
	depends on !BR2_STATIC_LIBS
	depends on BR2_USE_MMU # fork()
	help
		webserver

comment "webserver needs a toolchain w/ dynamic library"
	depends on BR2_USE_MMU
	depends on BR2_STATIC_LIBS
```
